## firmware/zmk/Kconfig
```kconfig
# SPDX-License-Identifier: Apache-2.0
rsource "drivers/gpio/Kconfig"
rsource "drivers/usb/device/Kconfig"

if BOARD_GMK70_WIRED
config GMK70_NATIVE_SPLIT
	bool "Native ZMK split cores with GMK70 runtime roles and board transport"
	depends on ZMK_SPLIT && ZMK_SPLIT_ROLE_CENTRAL
	help
	  Keep the legacy board UART framing for updater/RGB and snapshot recovery.
	  Reuse upstream central event and peripheral behavior-command processing.

rsource "drivers/kscan/Kconfig"
rsource "update/Kconfig"
rsource "studio/Kconfig"
rsource "lighting/Kconfig"
rsource "battery/Kconfig"
rsource "radio/Kconfig"
rsource "function_flip/Kconfig"
rsource "nkro/Kconfig"

config GMK70_CONTROLS
	bool "GMK70 native indicators and persistent board controls"
	depends on GMK70_ZMK_STUDIO_SETTINGS && GMK70_NKRO
	select ZMK_HID_INDICATORS
	default y

config GMK70_RECOVERY
	bool "GMK70 native reset and factory bootloader integration"
	depends on GMK70_ZMK_STUDIO_SETTINGS && !RETENTION_BOOT_MODE
	default y

config INPUT_THREAD_PRIORITY_OVERRIDE
	bool
	depends on ZMK_POINTING && INPUT_MODE_SYNCHRONOUS
	help
	  The pinned ZMK pointing subsystem selects this flag unconditionally.
	  Admit that unused priority selection in synchronous mode without
	  reserving an input thread or changing the pinned framework sources.

rsource "power/Kconfig"
endif

config GMK70_TRIAL_MAIN_RETURN
	bool "Experimental software-reset proof after successful ZMK main"
	depends on BOARD_GMK70_RIGHT
	default n
```

## firmware/zmk/battery/Kconfig
```kconfig
# SPDX-License-Identifier: GPL-2.0-or-later
config GMK70_BATTERY
    bool "GMK70 stock radio percentage and charger-status inputs"
    depends on BOARD_GMK70_WIRED && GMK70_ZMK_STUDIO_SETTINGS
    select ZMK_BATTERY_REPORTING
    help
      Opt-in Studio integration. Only the physical LEFT initializes UART3.
      Poll the unchanged stock radio with its battery inquiry and ACK messages;
      expose fresh percentages through the native state-of-charge sensor.
      A7 and A15 provide cable and hardware full-status indications.
      This does not implement a wireless keyboard endpoint or voltage reading.
```

## firmware/zmk/boards/zuoya/gmk70_left/Kconfig.defconfig
```kconfig
# SPDX-License-Identifier: Apache-2.0
if BOARD_GMK70_LEFT
config ZMK_KEYBOARD_NAME
	default "GMK70 Left ZMK Trial"
config ZMK_BOARD_COMPAT
	default y
endif
```

## firmware/zmk/boards/zuoya/gmk70_left/Kconfig.gmk70_left
```kconfig
# SPDX-License-Identifier: Apache-2.0
config BOARD_GMK70_LEFT
	select SOC_WB32FQ95
```

## firmware/zmk/boards/zuoya/gmk70_left/board.yml
```yaml
board:
  name: gmk70_left
  full_name: ZUOYA GMK70 left staging USB trial
  vendor: zuoya
  socs:
    - name: wb32fq95
```

## firmware/zmk/boards/zuoya/gmk70_right/Kconfig.defconfig
```kconfig
# SPDX-License-Identifier: Apache-2.0
if BOARD_GMK70_RIGHT
config ZMK_KEYBOARD_NAME
	default "GMK70 Right ZMK Trial"
config ZMK_BOARD_COMPAT
	default y
endif
```

## firmware/zmk/boards/zuoya/gmk70_right/Kconfig.gmk70_right
```kconfig
# SPDX-License-Identifier: Apache-2.0
config BOARD_GMK70_RIGHT
	select SOC_WB32FQ95
```

## firmware/zmk/boards/zuoya/gmk70_right/board.yml
```yaml
board:
  name: gmk70_right
  full_name: ZUOYA GMK70 right staging USB trial
  vendor: zuoya
  socs:
    - name: wb32fq95
```

## firmware/zmk/boards/zuoya/gmk70_wired/Kconfig.defconfig
```kconfig
# SPDX-License-Identifier: Apache-2.0
if BOARD_GMK70_WIRED
config ZMK_KEYBOARD_NAME
	default "GMK70 ZMK Wired"
config ZMK_BOARD_COMPAT
	default y
endif
```

## firmware/zmk/boards/zuoya/gmk70_wired/board.yml
```yaml
board:
  name: gmk70_wired
  full_name: ZUOYA GMK70 experimental unlocked wired updater
  vendor: zuoya
  socs:
    - name: wb32fq95
```

## firmware/zmk/boards/zuoya/gmk70_wired/gmk70_wired_defconfig
```kconfig
CONFIG_GPIO=y
CONFIG_USB_DEVICE_STACK=y
CONFIG_USB_DC_WB32=y
CONFIG_ZMK_USB=y
CONFIG_ZMK_BLE=n
CONFIG_ZMK_SPLIT=n
CONFIG_ZMK_SLEEP=n
CONFIG_PM=n
CONFIG_PM_DEVICE=n
CONFIG_SETTINGS=n
CONFIG_FLASH=n
CONFIG_NVS=n
CONFIG_SERIAL=n
CONFIG_CONSOLE=n
CONFIG_UART_CONSOLE=n
CONFIG_LOG=n
CONFIG_PRINTK=n
CONFIG_BOOT_BANNER=n
CONFIG_BUILD_OUTPUT_BIN=y
CONFIG_BUILD_OUTPUT_HEX=y
CONFIG_MAIN_STACK_SIZE=2048
CONFIG_SYSTEM_WORKQUEUE_STACK_SIZE=1536
CONFIG_HEAP_MEM_POOL_SIZE=0
CONFIG_USB_DEVICE_PRODUCT="GMK70 ZMK Wired"
CONFIG_USB_DEVICE_MANUFACTURER="HS"
CONFIG_USB_DEVICE_VID=0x342D
CONFIG_USB_DEVICE_PID=0xE491
CONFIG_USB_HID_DEVICE_COUNT=2
CONFIG_ENABLE_HID_INT_OUT_EP=y
CONFIG_HID_INTERRUPT_EP_MPS=32
CONFIG_KSCAN_GMK70_WIRED=y
CONFIG_GMK70_ZMK_UPDATER=y
CONFIG_GMK70_ZMK_PEER_TRIAL_RELAY=y
CONFIG_ZMK_RGB_UNDERGLOW=y
CONFIG_ZMK_RGB_UNDERGLOW_EXT_POWER=n
CONFIG_ZMK_RGB_UNDERGLOW_BRT_MAX=32
CONFIG_ZMK_RGB_UNDERGLOW_BRT_START=20
CONFIG_ZMK_RGB_UNDERGLOW_HUE_START=200
CONFIG_ZMK_RGB_UNDERGLOW_SAT_START=100
CONFIG_ZMK_RGB_UNDERGLOW_EFF_START=0
CONFIG_ZMK_RGB_UNDERGLOW_ON_START=y
```

## firmware/zmk/drivers/gpio/Kconfig
```kconfig
# SPDX-License-Identifier: Apache-2.0
config GPIO_WB32
	bool "Westberry WB32 GPIO (polled)"
	default y
	depends on DT_HAS_WESTBERRY_WB32_GPIO_ENABLED
	depends on GPIO
```

## firmware/zmk/drivers/kscan/Kconfig
```kconfig
# SPDX-License-Identifier: GPL-2.0-or-later
config KSCAN_GMK70_WIRED
    bool "GMK70 wired universal-role 10x9 matrix"
    depends on KSCAN && SOC_WB32FQ95
    default y if DT_HAS_ZUOYA_GMK70_WIRED_ENABLED
    help
      Native five-row local scan and Vial-compatible UART1 split transport.
      Right physical rows are delivered as logical rows 5..9. No radio support.
```

## firmware/zmk/drivers/usb/device/Kconfig
```kconfig
# SPDX-License-Identifier: Apache-2.0
config USB_DC_WB32
    bool "Westberry WB32 USB device controller"
    default y
    depends on DT_HAS_WESTBERRY_WB32_USB_ENABLED
    depends on USB_DEVICE_STACK
    help
      Legacy usb_dc driver for the WB32FQ95 indexed full-speed controller.
      Supports EP0 and three bidirectional bulk or interrupt endpoints with
      maximum packets of 64 bytes. Isochronous and remote wakeup are unsupported.
```

## firmware/zmk/dts/bindings/behaviors/zuoya,gmk70-behavior-battery.yaml
```yaml
# SPDX-License-Identifier: GPL-2.0-or-later
description: Held GMK70 battery level or charging-status RGB indicator
compatible: "zuoya,gmk70-behavior-battery"
include: one_param.yaml
```

## firmware/zmk/dts/bindings/behaviors/zuoya,gmk70-behavior-controls.yaml
```yaml
# SPDX-License-Identifier: GPL-2.0-or-later
description: |
  Persistent GMK70 GUI-key lock, Windows/Mac mode and USB-sleep preference.
  One action parameter uses the constants in dt-bindings/zmk/gmk70_controls.h.
  Actions apply on press through the shared native preferences adapter.
compatible: "zuoya,gmk70-behavior-controls"
include: one_param.yaml
```

## firmware/zmk/dts/bindings/behaviors/zuoya,gmk70-behavior-function-flip.yaml
```yaml
# SPDX-License-Identifier: GPL-2.0-or-later
description: GMK70 persistent function/media flip
compatible: "zuoya,gmk70-behavior-function-flip"
include: zero_param.yaml
```

## firmware/zmk/dts/bindings/behaviors/zuoya,gmk70-behavior-nkro.yaml
```yaml
# SPDX-License-Identifier: GPL-2.0-or-later
description: GMK70 NKRO toggle, enable or disable
compatible: "zuoya,gmk70-behavior-nkro"
include: one_param.yaml
```

## firmware/zmk/dts/bindings/behaviors/zuoya,gmk70-behavior-radio.yaml
```yaml
# SPDX-License-Identifier: GPL-2.0-or-later
description: GMK70 USB, Bluetooth profile and proprietary dongle selection
compatible: "zuoya,gmk70-behavior-radio"
include: one_param.yaml
```

## firmware/zmk/dts/bindings/behaviors/zuoya,gmk70-behavior-recovery.yaml
```yaml
# SPDX-License-Identifier: GPL-2.0-or-later
description: Deliberate native reset, factory bootloader and application settings reset
compatible: "zuoya,gmk70-behavior-recovery"
include: one_param.yaml
```

## firmware/zmk/dts/bindings/behaviors/zuoya,gmk70-behavior-sleep.yaml
```yaml
# SPDX-License-Identifier: GPL-2.0-or-later
description: |
  Persistent GMK70 inactivity timeout using the stock selector values.
  Values 0 through 7 mean never, 1, 3, 5, 10, 20, 30 minutes and default
  (5 minutes). Changing this preference does not enter sleep immediately.
compatible: "zuoya,gmk70-behavior-sleep"
include: one_param.yaml
```

## firmware/zmk/dts/bindings/gpio/westberry,wb32-gpio.yaml
```yaml
description: Westberry WB32 GPIO port (polled GPIO only)
compatible: "westberry,wb32-gpio"
include: [gpio-controller.yaml, base.yaml]
properties:
  reg:
    required: true
  clock-bit:
    type: int
    required: true
  "#gpio-cells":
    const: 2
gpio-cells:
  - pin
  - flags
```

## firmware/zmk/dts/bindings/kscan/zuoya,gmk70-wired.yaml
```yaml
# SPDX-License-Identifier: GPL-2.0-or-later
description: GMK70 universal-role wired 10 by 9 matrix and UART split transport
compatible: "zuoya,gmk70-wired"
include: kscan.yaml
```

## firmware/zmk/dts/bindings/led_strip/zuoya,gmk70-rgb.yaml
```yaml
# SPDX-License-Identifier: Apache-2.0
description: GMK70 virtual RGB strip over WB32 SPIM2 and the wired peripheral
compatible: "zuoya,gmk70-rgb"
include: led-strip.yaml
```

## firmware/zmk/dts/bindings/sensor/zuoya,gmk70-battery.yaml
```yaml
# SPDX-License-Identifier: GPL-2.0-or-later
description: GMK70 stock radio percentage cached by the physical LEFT worker
compatible: "zuoya,gmk70-battery"
include: sensor-device.yaml
```
