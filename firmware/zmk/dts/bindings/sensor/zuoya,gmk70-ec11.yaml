## firmware/zmk/dts/bindings/sensor/zuoya,gmk70-ec11.yaml
```yaml
description: GMK70 EC11 with runtime handedness and deferred LEFT-only startup
compatible: "zuoya,gmk70-ec11"
include: ["alps,ec11.yaml", "base.yaml"]
```

## firmware/zmk/dts/bindings/usb/westberry,wb32-usb.yaml
```yaml
# SPDX-License-Identifier: Apache-2.0

description: Westberry WB32FQ95 full-speed USB device controller

compatible: "westberry,wb32-usb"

include: usb-controller.yaml

properties:
  reg:
    required: true
  interrupts:
    required: true
```

## firmware/zmk/function_flip/Kconfig
```kconfig
# SPDX-License-Identifier: GPL-2.0-or-later
config GMK70_FUNCTION_FLIP
    bool "GMK70 persistent stock function/media flip"
    depends on BOARD_GMK70_WIRED && GMK70_ZMK_STUDIO_SETTINGS && ZMK_RGB_UNDERGLOW
    help
      Studio-assignable stock Windows/Mac number/F-row flip, with matching
      held-key releases and guarded deferred settings persistence.
```

## firmware/zmk/lighting/Kconfig
```kconfig
# SPDX-License-Identifier: Apache-2.0
config GMK70_WB32_RGB
    bool "GMK70 native WB32 RGB strip and wired frame transport"
    depends on BOARD_GMK70_WIRED && ZMK_RGB_UNDERGLOW
    default y
    help
      B15/SPIM2 and DMAC2 channel 0 drive the 36/41 RGB-order WS2812 LEDs.
      The left renders a virtual 77-pixel strip and synchronizes complete
      peripheral frames over the existing 16-byte wired RGB transaction.

config GMK70_RGB_LOCAL_ONLY
    bool "Do not send lighting frames to an unchanged older peer"
    depends on GMK70_WB32_RGB
    help
      Development isolation for a LEFT-only update experiment. Render local
      pixels but leave the older RIGHT application and its UART traffic alone.
```

## firmware/zmk/nkro/Kconfig
```kconfig
# SPDX-License-Identifier: GPL-2.0-or-later
config GMK70_NKRO
    bool
    depends on BOARD_GMK70_WIRED && ZMK_USB
    default y
    select ZMK_HID_KEYBOARD_NKRO_EXTENDED_REPORT
    select ZMK_USB_BOOT
    help
      Native NKRO and USB boot fallback, with a Studio-assignable toggle.
      Disabled mode limits reports to six ordinary keys without changing
      the report descriptor. Studio builds remember the mode using the
      existing gated settings backend; other profiles are runtime-only.
```

## firmware/zmk/power/Kconfig
```kconfig
# SPDX-License-Identifier: GPL-2.0-or-later
config GMK70_POWER
	bool "GMK70 coordinated native sleep and runtime storage"
	depends on GMK70_CONTROLS && GMK70_RADIO
	default y
	select HAS_POWEROFF
	select ZMK_SLEEP
	select ZMK_PM_SOFT_OFF
	help
	  Native inactivity and power-off policy with existing WB32 STOP/wake
	  hardware and the stock radio's own sleep firmware. Both halves must
	  advertise the coordinated power protocol before joined sleep is used.
	  Runtime preference saves use an idle storage lease; updater and Studio
	  writes retain their existing wired/USB authorization.

config GMK70_EVENT_IDLE
	bool "GMK70 IRQ and deadline driven idle"
	depends on GMK70_POWER
	default y
	help
	  Block quiet workers on IRQ notifications and negotiate reliable split
	  matrix events. Old peers keep the original polling protocol. Scheduling
	  notifications and maintenance messages never refresh user inactivity.

config GMK70_RETAINED_SLEEP
	bool "GMK70 returning full-suspend STOP"
	depends on GMK70_EVENT_IDLE && ZMK_POINTING && CORTEX_M_SYSTICK && CORTEX_M_SYSTICK_64BIT_CYCLE_COUNTER
	default y
	help
	  Retain SRAM/framework state across coordinated STOP. Uses a calibrated
	  LSI RTC without resetting a foreign backup domain, restores RCC before
	  GPIO/UART access, and catches up kernel time before normal work resumes.
	  Native USB shallow sleep and critical-power/reset fallbacks remain.
```

## firmware/zmk/radio/Kconfig
```kconfig
# SPDX-License-Identifier: GPL-2.0-or-later
config GMK70_RADIO
    bool "GMK70 stock vendor-radio Bluetooth and dongle endpoint"
    depends on BOARD_GMK70_WIRED && GMK70_ZMK_STUDIO_SETTINGS
    select GMK70_BATTERY
    help
      Reuse the sole UART3 battery owner for stock keyboard/consumer reports,
      channel selection and pairing without modifying radio firmware or bonds.
      Native USB remains available for Studio and the guarded updater.

config GMK70_RADIO_QUALIFICATION
    bool "Temporary radio qualification with a fixed F24 test marker"
    depends on GMK70_RADIO
    default n
    help
      Separate, explicitly named development image only. Adds one bounded
      F24 press/release test command; normal images do not contain this entry.
```

## firmware/zmk/soc/westberry/wb32fq95/Kconfig
```kconfig
# SPDX-License-Identifier: Apache-2.0
config SOC_WB32FQ95
	select ARM
	select CPU_CORTEX_M3
	select CPU_CORTEX_M_HAS_DWT
	select SOC_EARLY_INIT_HOOK
```

## firmware/zmk/soc/westberry/wb32fq95/Kconfig.soc
```kconfig
# SPDX-License-Identifier: Apache-2.0
config SOC_WB32FQ95
	bool

config SOC
	default "wb32fq95" if SOC_WB32FQ95
```

## firmware/zmk/studio/Kconfig
```kconfig
# SPDX-License-Identifier: Apache-2.0
config GMK70_ZMK_STUDIO_SETTINGS
    bool "Experimental GMK70 page settings backend for Studio"
    depends on SOC_WB32FQ95 && KSCAN_GMK70_WIRED && SETTINGS_CUSTOM && ZMK_STUDIO
    depends on !GMK70_STAGING_QUALIFICATION
    help
      Reserves the final 16 KiB of the application region for two snapshot
      banks. Only the board service worker writes complete WB32 flash pages.
```

## firmware/zmk/update/Kconfig
```kconfig
# SPDX-License-Identifier: GPL-2.0-or-later
config GMK70_STANDALONE
    bool "GMK70 direct-boot firmware without a resident or upload receiver"
    depends on SOC_WB32FQ95 && KSCAN_GMK70_WIRED && ZMK_USB
    select REBOOT
    select SOC_RESET_HOOK

config GMK70_ZMK_UPDATER
    bool "GMK70 native raw HID firmware updater"
    depends on SOC_WB32FQ95 && KSCAN_GMK70_WIRED && ZMK_USB
    depends on !GMK70_STANDALONE
    select REBOOT
    select GMK70_NATIVE_UPDATE_WIRE
    help
      Development updater using the installed GMK70 resident ABI and wired
      relay. Requires two USB HID interfaces, interrupt OUT, and 32-byte HID
      endpoint buffers. Host writes require left USB, wired mode, a ready
      update service and the matching local/peer role. Permanent firmware never
      starts or feeds a hardware watchdog. This build is explicitly unlocked.

config GMK70_NATIVE_UPDATE_WIRE
    bool
    select RING_BUFFER
    select CRC
    help
      Reuse pinned native ZMK framing/parser and CRC32 for updater relay.

config GMK70_NATIVE_UPDATE_LEGACY_BRIDGE
    bool "Temporary native/legacy updater migration bridge"
    depends on GMK70_NATIVE_UPDATE_WIRE
    default n
    help
      Explicit migration build only: safely discover native-capable peers and
      retain RPC18 for older applications. Canonical builds use native frames.

config GMK70_STAGING_QUALIFICATION
    bool "GMK70 restricted staging qualification receiver"
    depends on GMK70_ZMK_UPDATER
    help
      Executing from staging: do not initialize or feed the permanent watchdog.
      Permit read-only identity/health and local BEGIN/ABORT only; BEGIN may
      erase the isolated commit page. Never stage DATA, SEAL, INSTALL or relay
      peer mutations. This image is experimental, not a permanent artifact.

config GMK70_RESIDENT_RECEIVER
    bool
    default y if GMK70_ZMK_UPDATER && !GMK70_STAGING_QUALIFICATION
    help
      Mark native startup as compatible with the unchanged resident handoff.
      Receiving through handoff does not require using it for outgoing updates.

config GMK70_ZMK_PEER_TRIAL_RELAY
    bool "GMK70 relay for qualification of an installed Vial right peer"
    depends on GMK70_ZMK_UPDATER && !GMK70_STAGING_QUALIFICATION
    help
      Forward validated trial ABI2 packets from left USB to target1 only.
      This enables staging qualification of a still-Vial right peer before
      replacing its application. No local trial execution or watchdog handoff
      is provided. Peer mutations require the ready update service and the same
      left/configured-USB/wired gates as the normal updater.
```
